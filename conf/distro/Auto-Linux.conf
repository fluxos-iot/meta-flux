## conf/distro/flux.conf
```bitbake
DISTRO = "flux"
DISTRO_NAME = "Flux (A easy to be deployed OS based on Yocto)"
DISTRO_VERSION = "1.0.0"
SDK_VENDOR = "-fluxsdk"
SDK_VERSION := "${@'${DISTRO_VERSION}'.replace('snapshot-${DATE}','snapshot')}"

MAINTAINER = "FluxOS <fluxos.iot@gmail.com>"

TARGET_VENDOR = "-flux"

LOCALCONF_VERSION = "1"

DISTRO_VERSION[vardepsexclude] = "DATE"
SDK_VERSION[vardepsexclude] = "DATE"

TCLIBCAPPEND = ""

# The CONNECTIVITY_CHECK_URI's are used to test whether we can succesfully
# fetch from the network (and warn you if not). To disable the test set
# the variable to be empty.
# Git example url: git://git.yoctoproject.org/yocto-firewall-test;protocol=git;rev=master
CONNECTIVITY_CHECK_URIS ?= "https://www.example.com/"

SANITY_TESTED_DISTROS ?= " \
            ubuntu-16.04 \n \
            "
#
# OELAYOUT_ABI allows us to notify users when the format of TMPDIR changes in
# an incompatible way. Such changes should usually be detailed in the commit
# that breaks the format and have been previously discussed on the mailing list
# with general agreement from the core team.
#
OELAYOUT_ABI = "11"

# Activate systemd
VIRTUAL-RUNTIME_init_manager = "systemd"
VIRTUAL-RUNTIME_syslog = "sysklogd"
DISTRO_FEATURES_BACKFILL_CONSIDERED += "sysvinit"
KERNEL_FEATURES_append = " cfg/systemd.scc"

DISTRO_FEATURES_append = " systemd virtualization"

USER_CLASSES = "buildhistory buildstats buildstats-summary"
BUILDHISTORY_COMMIT = "1"

# Please redefine OSTREE_REPO in order to have a persistent OSTree repo
OSTREE_REPO ?= "${DEPLOY_DIR_IMAGE}/ostree_repo"
# For UPTANE operation, OSTREE_BRANCHNAME must start with "${MACHINE}-"
OSTREE_BRANCHNAME ?= "${MACHINE}-ota"
OSTREE_OSNAME ?= "flux-essential"
OSTREE_BOOTLOADER ??= 'u-boot'
OSTREE_INITRAMFS_IMAGE ?= "initramfs-ostree-image"

INITRAMFS_FSTYPES = "${@oe.utils.ifelse(d.getVar('OSTREE_BOOTLOADER', True) == 'u-boot', 'ext4.gz.u-boot', 'ext4.gz')}"

include conf/machine/${MACHINE}.conf.inc
```

## conf/layer.conf
```bitbake
BBPATH .= ":${LAYERDIR}"

BBFILES += "${LAYERDIR}/recipes-*/*/*.bb \
	${LAYERDIR}/recipes-*/*/*.bbappend"

BBFILE_COLLECTIONS += "flux"
BBFILE_PATTERN_flux = "^${LAYERDIR}/"
BBFILE_PRIORITY_flux = "10"
```

## conf/machine/microzed-zynq7.conf.inc
```bitbake
# Override IMAGE_BOOT_FILES
IMAGE_BOOT_FILES_microzed-zynq7 = "${UBOOT_BINARY} boot.bin ${MACHINE}.dtb uEnv.txt"

OSTREE_KERNEL_ARGS = "console=ttyPS0,115200 ostree_root=/dev/mmcblk0p2 root=/dev/ram0 rootfstype=ext4 rw rootwait rootdelay=2 earlyprintk"
```

## conf/machine/qemux86-64.conf.inc
```bitbake
# See https://advancedtelematic.atlassian.net/browse/PRO-2693
PREFERRED_VERSION_linux-yocto-rt_qemux86-64 = "4.4%"
PREFERRED_PROVIDER_virtual/kernel = "linux-yocto-rt"

# U-Boot support for OTA
PREFERRED_PROVIDER_virtual/bootloader = "u-boot-ota"
UBOOT_MACHINE = "qemu-x86_defconfig"
OSTREE_BOOTLOADER ?= "u-boot"

OSTREE_KERNEL_ARGS ?= "ramdisk_size=16384 rw rootfstype=ext4 rootwait rootdelay=2 ostree_root=/dev/hda"
```

## scripts/lib/wic/canned-wks/sdimage-ota-microzed-zynq7.wks
```
# short-description: Create SD card image with a boot partition
# long-description: Creates a partitioned SD card image. Boot files
# are located in the first vfat partition.

part /boot --source bootimg-partition --ondisk mmcblk --fstype=vfat --label boot --active --align 4 --size 16
part / --source rawcopy --sourceparams="file=flux-image-essential-microzed-zynq7.otaimg" --ondisk mmcblk --fstype=ext4 --label root --align 4
part /var/lib/balena --ondisk mmcblk --fstype=ext4 --label fluxdata --align 4 --size 16
```
